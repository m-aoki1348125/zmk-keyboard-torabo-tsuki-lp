#include "torabo_tsuki_lp.dtsi"

/ {
    trackball_transform: trackball_transform {
        compatible = "zmk,input-processor-transform";
        #input-processor-cells = <0>;
        type = <INPUT_EV_REL>;
        codes = <INPUT_REL_X>, <INPUT_REL_Y>;
        x-invert;
        y-invert;
    };
};

&size_s_transform {
    col-offset = <7>;
};

// &size_m_transform {
//     col-offset = <7>;
// };

&size_l_transform {
    col-offset = <7>;
};